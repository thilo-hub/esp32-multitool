## esptunnel/main/Kconfig.projbuild
```kconfig
menu "Toolbox Configuration"

menu "System Console Configuration"
    orsource "$IDF_PATH/examples/common_components/env_caps/$IDF_TARGET/Kconfig.env_caps"
    config CONSOLE_STORE_HISTORY
        bool "Store command history in flash"
        default y
        help
            Linenoise line editing library provides functions to save and load
            command history. If this option is enabled, initalizes a FAT filesystem
            and uses it to store command history.

    config CONSOLE_MAX_COMMAND_LINE_LENGTH
        int "Maximum command line length"
        default 1024
        help
            This value marks the maximum length of a single command line. Once it is
            reached, no more characters will be accepted by the console.

endmenu

	config WIFI_TUNNEL
	bool "Enable wifi tunnel via uart & SPI"
	default y

    config UARTIF_ENABLED
	depends on WIFI_TUNNEL
    	bool "Enable UART for data com"
	default y
	help
		Even if no data comm via uart is enabled, it is still needed for parameter and sync communication

    config UARTIF_UART
	depends on WIFI_TUNNEL
	int "UART for ip comm"
        range 1 2
	default 2
	help
		Uart for ip communications should have RTS/CTS pins


    config GPIO_UARTIF_TX
	depends on WIFI_TUNNEL
	int "UART tx-pin output for ip comm"
        range ENV_GPIO_RANGE_MIN ENV_GPIO_OUT_RANGE_MAX
	default 17
	help
		Uart for ip communications should have RTS/CTS pins


    config GPIO_UARTIF_RX
	depends on WIFI_TUNNEL
	int "UART rx-pin input for ip comm"
        range ENV_GPIO_RANGE_MIN ENV_GPIO_OUT_RANGE_MAX
	default 16
	help
		Uart for ip communications should have RTS/CTS pins


    config GPIO_UARTIF_RTS
	depends on WIFI_TUNNEL
	int "UART rts-pin input for ip comm"
        range ENV_GPIO_RANGE_MIN ENV_GPIO_OUT_RANGE_MAX
	default 14
	help
		Uart for ip communications should have RTS/CTS pins


    config GPIO_UARTIF_CTS
	depends on WIFI_TUNNEL
	int "UART cts-pin output for ip comm"
        range ENV_GPIO_RANGE_MIN ENV_GPIO_OUT_RANGE_MAX
	default 15
	help
		Uart for ip communications should have RTS/CTS pins

    config SPIO_ENABLED
	depends on WIFI_TUNNEL
    	bool "Use SPI for communication"
	default y

    config SPIO_GPIO_HANDSHAKE 
    	depends on SPIO_ENABLED
	int "SPI handshake output to host"
        range ENV_GPIO_RANGE_MIN ENV_GPIO_IN_RANGE_MAX
	default 0 

    config SPIO_GPIO_MOSI 
    	depends on SPIO_ENABLED
	int "SPI input"
        range ENV_GPIO_RANGE_MIN ENV_GPIO_IN_RANGE_MAX
        default 11

    config SPIO_GPIO_MISO 
    	depends on SPIO_ENABLED
	int "SPI output"
        range ENV_GPIO_RANGE_MIN ENV_GPIO_IN_RANGE_MAX
        default 13

    config SPIO_GPIO_SCLK 
    	depends on SPIO_ENABLED
	int "SPI SCLK input"
        range ENV_GPIO_RANGE_MIN ENV_GPIO_IN_RANGE_MAX
        default 12

    config SPIO_GPIO_CS 
    	depends on SPIO_ENABLED
	int "SPI CS input"
        range ENV_GPIO_RANGE_MIN ENV_GPIO_IN_RANGE_MAX
        default 10

	config WEBSERVER
	bool "Enable webinterface"
	default n

menu "Webserver Configuration"
	depends on WEBSERVER
    config WEBSERVER_AUTOSTART
    	bool "Auto start webserver"
	default n

    config UARTCON_ENABLE
	depends on WEBSERVER
    	bool "Enable remote console uart"
	default false
	select BASIC_AUTH

    config UARTCON_UART  
        depends on UARTCON_ENABLE
    	int "ESP32 Uart # to use for console"
    	default 1
	help
		ESP32 Uart to use to connect
    config GPIO_UARTCON_TX  
        depends on UARTCON_ENABLE
	default 37
        int "Uart TX pin"
        range ENV_GPIO_RANGE_MIN ENV_GPIO_OUT_RANGE_MAX
    config GPIO_UARTCON_RX  
        depends on UARTCON_ENABLE
	default 36
        int "Uart RX pin"
        range ENV_GPIO_RANGE_MIN ENV_GPIO_OUT_RANGE_MAX
    config UARTCON_PORT 
        depends on UARTCON_ENABLE
	int "Port to listen for console"
	default 9876
    config GPIO_RESET_PIN
        depends on BASIC_AUTH
	int "Gpio to toggle to reset Beaglebone"
	default 9
    config BASIC_AUTH
        bool "Basic Authentication"
        default y
        help
            Basic Authentication is a method for an HTTP user agent (e.g. a web browser)
            to provide a user name and password when making a request. It is the simplest
            technique for enforcing access controls to web resources. because it doesn't
            require cookies, session identifiers, or login pages; rather, it uses standard
            fields in the HTTP header.
            Note that, Basic Authentication is not encrypted channel and also easy to retrieve
            credentials as they are sent in plain text format.

    config BASIC_AUTH_USERNAME
        string "Basic Authenticate User Name"
        depends on BASIC_AUTH
        default "ESP32"
        help
            The client's user name which used for basic authenticate.

    config BASIC_AUTH_PASSWORD
        string "Basic Authenticate Password"
        depends on BASIC_AUTH
        default "ESP32Webserver"
        help
            The client's password which used for basic authenticate.

endmenu

	config RF433
	bool "Enable rf433 commands"
	default y

menu "RF433 Interface Configuration"
    depends on RF433
    config GPIO_RF433_TX
        int "GPIO output pin to rf433 transmitter"
        range ENV_GPIO_RANGE_MIN ENV_GPIO_OUT_RANGE_MAX
        default 8 if IDF_TARGET_ESP32C2 || IDF_TARGET_ESP32H4 || IDF_TARGET_ESP32H2
        default 20
        help
            GPIO pin number to be used to send rf433 data stream

    config GPIO_RF433_RX
        int "GPIO input pin from rf433 receiver"
        range ENV_GPIO_RANGE_MIN ENV_GPIO_IN_RANGE_MAX
        default 3
        help
            GPIO pin number to be used as rf433 rx
endmenu
endmenu
```

## esptunnel/sdkconfig.defaults
```kconfig
CONFIG_LWIP_LOCAL_HOSTNAME="beaglebone"
CONFIG_PARTITION_TABLE_CUSTOM=y
CONFIG_PARTITION_TABLE_CUSTOM_FILENAME="partitions_example.csv"
CONFIG_PARTITION_TABLE_FILENAME="partitions_example.csv"
CONFIG_ESPTOOLPY_FLASHSIZE_8MB=y
```

## rf433/main/Kconfig.projbuild
```kconfig
menu "RF433 Interface Configuration"

    orsource "$IDF_PATH/examples/common_components/env_caps/$IDF_TARGET/Kconfig.env_caps"

    config GPIO_RF433_TX
        int "GPIO output pin to rf433 transmitter"
        range ENV_GPIO_RANGE_MIN ENV_GPIO_OUT_RANGE_MAX
        default 8 if IDF_TARGET_ESP32C2 || IDF_TARGET_ESP32H4 || IDF_TARGET_ESP32H2
        default 20
        help
            GPIO pin number to be used to send rf433 data stream

    config GPIO_RF433_RX
        int "GPIO input pin from rf433 receiver"
        range ENV_GPIO_RANGE_MIN ENV_GPIO_IN_RANGE_MAX
        default 3
        help
            GPIO pin number to be used as rf433 rx

endmenu
menu "System Console Configuration"

    config CONSOLE_STORE_HISTORY
        bool "Store command history in flash"
        default y
        help
            Linenoise line editing library provides functions to save and load
            command history. If this option is enabled, initalizes a FAT filesystem
            and uses it to store command history.

    config CONSOLE_MAX_COMMAND_LINE_LENGTH
        int "Maximum command line length"
        default 1024
        help
            This value marks the maximum length of a single command line. Once it is
            reached, no more characters will be accepted by the console.

endmenu
menu "Webserver Configuration"

    config EXAMPLE_BASIC_AUTH
        bool "Basic Authentication"
        default y
        help
            Basic Authentication is a method for an HTTP user agent (e.g. a web browser)
            to provide a user name and password when making a request. It is the simplest
            technique for enforcing access controls to web resources. because it doesn't
            require cookies, session identifiers, or login pages; rather, it uses standard
            fields in the HTTP header.
            Note that, Basic Authentication is not encrypted channel and also easy to retrieve
            credentials as they are sent in plain text format.

    config EXAMPLE_BASIC_AUTH_USERNAME
        string "Basic Authenticate User Name"
        depends on EXAMPLE_BASIC_AUTH
        default "ESP32"
        help
            The client's user name which used for basic authenticate.

    config EXAMPLE_BASIC_AUTH_PASSWORD
        string "Basic Authenticate Password"
        depends on EXAMPLE_BASIC_AUTH
        default "ESP32Webserver"
        help
            The client's password which used for basic authenticate.

endmenu
menu "Remote Uart Console"
    config UARTIF_UART  
        depends on EXAMPLE_BASIC_AUTH
    	int "Uart to use for console"
    	default 2
	help
		ESP32 Uart to use to connect
    config GPIO_UARTIF_TX  
        depends on EXAMPLE_BASIC_AUTH
	default 17
        int "Uart TX pin"
        range ENV_GPIO_RANGE_MIN ENV_GPIO_OUT_RANGE_MAX
    config GPIO_UARTIF_RX  
        depends on EXAMPLE_BASIC_AUTH
	default 16
        int "Uart RX pin"
        range ENV_GPIO_RANGE_MIN ENV_GPIO_OUT_RANGE_MAX
    config UARTIF_PORT 
        depends on EXAMPLE_BASIC_AUTH
	int "Port to listen for console"
	default 9876
    config GPIO_RESET_PIN
        depends on EXAMPLE_BASIC_AUTH
	int "Gpio to toggle to reset Beaglebone"
	default 9
endmenu
```

## rf433/sdkconfig.defaults
```kconfig
CONFIG_PARTITION_TABLE_CUSTOM=y
CONFIG_PARTITION_TABLE_CUSTOM_FILENAME="partitions.csv"
CONFIG_PARTITION_TABLE_FILENAME="partitions.csv"
CONFIG_ESPTOOLPY_FLASHSIZE_8MB=y
CONFIG_SOC_SPI_MEM_SUPPORT_CONFIG_GPIO_BY_EFUSE=y
CONFIG_GPIO_RF433_TX=20
CONFIG_GPIO_RF433_RX=3
CONFIG_LWIP_LOCAL_HOSTNAME="beagle1w"
```
